/* Generated by tools/c_syms.py for main: names no object defines (172 relative to a label, 0 from the main executable, 8 fixed) */
PROVIDE(.L0045AD8C = GphClipTriDraw + 0x118);
PROVIDE(.L0045AED4 = GphClipTriDraw + 0x260);
PROVIDE(D_0049A540 = menuFrameParts + 0x18);
PROVIDE(D_0049A588 = menuFrameParts + 0x60);
PROVIDE(D_0049A68C = dbgEnvMapParam + 0xC);
PROVIDE(D_0049D6AC = movPlaylistTable + 0x4);
PROVIDE(D_0049D748 = movPlaylistTable + 0xA0);
PROVIDE(D_0049D760 = movPlaylistTable + 0xB8);
PROVIDE(D_004A067C = impure_data + 0x1E4);
PROVIDE(D_004A06D4 = impure_data + 0x23C);
PROVIDE(D_004A072C = impure_data + 0x294);
PROVIDE(D_004A07A8 = __malloc_av_ + 0x8);
PROVIDE(D_004A0B98 = __malloc_av_ + 0x3F8);
PROVIDE(D_004A2A00 = menuButtonPadSprites + 0x18);
PROVIDE(D_004A2A0C = menuButtonPadSprites + 0x24);
PROVIDE(D_004A3378 = sysPathGrxsysPac);
PROVIDE(D_004A3388 = sysPathSndIdx);
PROVIDE(D_004A33A0 = sysPathVmsInit);
PROVIDE(D_004A33B8 = sysPathSysSe);
PROVIDE(D_004A33C8 = sysPath6500Se);
PROVIDE(D_004A33D8 = sysPathFaceDat);
PROVIDE(D_004A63DC = menuLrArrowSprites + 0xC);
PROVIDE(D_004A6520 = menuHelpTailSprites + 0x18);
PROVIDE(D_004A677C = __rodata_main_42EDE0 + 0x1C);
PROVIDE(D_004A67EC = __rodata_main_430570 + 0xC);
PROVIDE(D_004A68A4 = __rodata_main_442558 + 0xC);
PROVIDE(D_004A6944 = __rodata_main_4506E8 + 0x14);
PROVIDE(D_004A7864 = atanhi + 0xC);
PROVIDE(D_004A7874 = atanlo + 0xC);
PROVIDE(D_004A7B80 = __rodata_main_data_4A7B80);
PROVIDE(D_004A8D38 = __mprec_bigtens + 0x20);
PROVIDE(D_004A9418 = sysGrxTable7C);
PROVIDE(D_004A941C = ptyManaEggTable);
PROVIDE(D_004A9420 = sysGrxTableA0);
PROVIDE(D_004A9424 = sysDropRankTable);
PROVIDE(D_004A9428 = ptyCharData);
PROVIDE(D_004A942C = ptyItemSortKeys);
PROVIDE(D_004A9430 = ptyEggFusionTable);
PROVIDE(D_004A9438 = sysDropItemTable);
PROVIDE(D_004A9440 = ptyItemTable);
PROVIDE(D_004A9444 = ptyPartyData);
PROVIDE(D_004A944C = ptyGrowthTable);
PROVIDE(D_004A9450 = ptyCharDefTable);
PROVIDE(D_004A945C = sysGrxsysPac);
PROVIDE(D_004A9460 = sysCombineTable);
PROVIDE(D_004A9478 = sysGbxPac);
PROVIDE(D_004A947C = ptySkillBookTypeTable);
PROVIDE(D_004A9480 = ptySkillTable);
PROVIDE(D_004A9488 = ptyComboTable);
PROVIDE(D_004A9494 = ptyMoveTable);
PROVIDE(D_004A9624 = __DTOR_LIST__ + 0x4);
PROVIDE(D_004A9AE0 = gphShatter + 0x20);
PROVIDE(D_004A9D40 = gphShatter + 0x280);
PROVIDE(D_004AC370 = sysDemo + 0x70);
PROVIDE(D_004E7420 = _sceMcFileInfoBuf + 0x20);
PROVIDE(D_004E7484 = _sceMcNameArg + 0x14);
PROVIDE(D_004EA128 = _sceTtyState + 0x18);
PROVIDE(D_004ED5C0 = sysTexUploadPacket);
PROVIDE(D_004EF198 = ptyCharStatsBuf);
PROVIDE(D_004F0D00 = sysState);
PROVIDE(D_004F21A0 = sysIni + 0xA0);
PROVIDE(D_004F2398 = sysIni + 0x298);
PROVIDE(D_004F24B4 = btlEntryMapNo + 0x24);
PROVIDE(D_004F24D4 = btlEntryMapNo + 0x44);
PROVIDE(D_004F24F4 = btlEntryMapNo + 0x64);
PROVIDE(D_004F257A = padTrigger + 0x2);
PROVIDE(D_004F2D60 = fileReadWork + 0x1E0);
PROVIDE(D_004F2DB0 = sndSeWork + 0x30);
PROVIDE(D_004F2DE8 = sndSeWork + 0x68);
PROVIDE(D_004F5E90 = sndBgmChannels + 0x40);
PROVIDE(D_10000 = 0x00010000);
PROVIDE(D_11004200 = 0x11004200);
PROVIDE(D_20000010 = 0x20000010);
PROVIDE(D_20000050 = 0x20000050);
PROVIDE(D_20000800 = 0x20000800);
PROVIDE(D_30000010 = 0x30000010);
PROVIDE(D_70002000 = 0x70002000);
PROVIDE(D_800009E0 = 0x800009E0);
PROVIDE(__localeDecimalPoint = _lconv + 0x38);
PROVIDE(__localeEmptyStr = _lconv + 0x30);
PROVIDE(_sceFsIoctlArg = _sceFsInitArg + 0x4);
PROVIDE(_sceFsRetBufExtra = _sceFsRetBufData + 0x4);
PROVIDE(_sceMpegIpuToSrcAddr = _sceMpegIpuToQwcLeft + 0x4);
PROVIDE(_sceSifCmdDataSysHandlers = _sceSifCmdDataIopBuf + 0x4);
PROVIDE(_sceSifCmdDataUsrHandlers = _sceSifCmdDataIopBuf + 0xC);
PROVIDE(amapSaveFloorIndex = evtMainFlag + 0xC);
PROVIDE(amapSaveFloorNo = sysSaveParty + 0x74);
PROVIDE(btlCamera = ptyCharDefTable + 0x4);
PROVIDE(btlHandoffDropCount = btlHandoffResult + 0x6);
PROVIDE(btlHandoffEndFade = btlHandoffResult + 0x67);
PROVIDE(btlHandoffIpStopOpt = btlHandoffResult + 0x54);
PROVIDE(camScrSysByte = gphFbDivParam + 0x5E);
PROVIDE(chrModelCreateHasDeform = chrModelCreatePktSize + 0x4);
PROVIDE(ctypeTable = _ctype_ + 0x1);
PROVIDE(dbgMotSpeedDefault = sysIni + 0x28);
PROVIDE(evtAreaMapFlags = sysSaveParty + 0x261);
PROVIDE(evtDungeonFlags = sysSaveParty + 0x267);
PROVIDE(evtGameFlags = sysSaveParty + 0x251);
PROVIDE(evtGlobalCounters = sysSaveParty + 0x39);
PROVIDE(evtGlobalFlags = sysSaveParty + 0x141);
PROVIDE(evtLocalCounters = sysSaveParty + 0x35);
PROVIDE(evtLocalFlags = sysSaveParty + 0x28F);
PROVIDE(evtMealCounters = sysSaveParty + 0x69);
PROVIDE(evtMonsterFlags = sysSaveParty + 0x26F);
PROVIDE(evtPointTalkCounters = sysSaveParty + 0x2D);
PROVIDE(evtReaderFlags = sysSaveParty + 0x265);
PROVIDE(evtSubGameCounters = sysSaveParty + 0xF1);
PROVIDE(evtSubGameFlags = sysSaveParty + 0x1C1);
PROVIDE(evtSubTime1Counters = sysSaveParty + 0x71);
PROVIDE(evtSubTime2Counters = sysSaveParty + 0x99);
PROVIDE(evtSystemFlags = sysSaveParty + 0x121);
PROVIDE(evtTalkCounters = sysSaveParty + 0xD);
PROVIDE(evtTreasureFlags = sysSaveParty + 0x241);
PROVIDE(evtXvsCounters = sysSaveParty + 0xC1);
PROVIDE(evtXvsFlags = sysSaveParty + 0x201);
PROVIDE(fileReadState = fileReadWork + 0x4);
PROVIDE(func_00480D48 = __floatdidf);
PROVIDE(func_00480DE0 = __muldi3);
PROVIDE(func_00481250 = dpadd);
PROVIDE(func_004812A8 = dpsub);
PROVIDE(func_00481310 = dpmul);
PROVIDE(func_004815B8 = dpdiv);
PROVIDE(func_00481838 = dpcmp);
PROVIDE(func_00481AE0 = dptofp);
PROVIDE(func_004826D8 = fptodp);
PROVIDE(func_0048281C = memset);
PROVIDE(func_004946F8 = __fixdfdi);
PROVIDE(func_00494758 = __fixunsdfdi);
PROVIDE(func_00494EB0 = __udivdi3);
PROVIDE(gphShatterHold = gphFbDivParam + 0x5D);
PROVIDE(gphShatterPrim = gphShatter + 0x80);
PROVIDE(gphShatterScene = gphShatter + 0x14);
PROVIDE(gsVblankHandlerId = gsTimerLastCount + 0x4);
PROVIDE(mapMiniCfgOff = sysSaveData + 0x29);
PROVIDE(mapMiniCfgZoom = sysSaveData + 0x27);
PROVIDE(mapVariantNo = sysSaveParty + 0x9);
PROVIDE(mcIconFileEntry = mcIconSysEntry + 0x28);
PROVIDE(mcIconFileName = __rodata_main_42C330 + 0x30);
PROVIDE(mcIconFileSize = mcIconSysEntry + 0x48);
PROVIDE(mcIconSysData = mcIconSysEntry + 0x24);
PROVIDE(mcIconSysSize = mcIconSysEntry + 0x20);
PROVIDE(mcPollInterval = mcCurPort + 0x4);
PROVIDE(mcReqQueueHead = mcReqQueue + 0x4);
PROVIDE(mcSaveDataPtr = mcIconSysEntry + 0x74);
PROVIDE(mcSaveDataSize = mcIconSysEntry + 0x70);
PROVIDE(mcSaveFileEntry = mcIconSysEntry + 0x50);
PROVIDE(menuHelpImmunityAllIcon = menuStatusIcons + 0x84);
PROVIDE(menuHelpLinkIcon = menuLargeDigitSprites + 0xB4);
PROVIDE(menuHelpMinusSprite = menuLargeDigitSprites + 0x84);
PROVIDE(menuHelpPlusSprite = menuLargeDigitSprites + 0x90);
PROVIDE(menuHelpStrBad = menuHelpElementTexts + 0x36);
PROVIDE(menuHelpStrElementSuffix = menuHelpElementTexts + 0x24);
PROVIDE(menuHelpStrGood = menuHelpElementTexts + 0x2D);
PROVIDE(menuHelpStrImmunity = menuHelpStatusTexts + 0xDD);
PROVIDE(menuIconEggSlotEmpty = menuItemIcons + 0x3A8);
PROVIDE(menuNumGlyphLevel = menuLargeDigitSprites + 0xC0);
PROVIDE(menuNumGlyphSlash = menuLargeDigitSprites + 0x9C);
PROVIDE(menuNumGlyphTimes = menuLargeDigitSprites + 0xA8);
PROVIDE(menuResultElementIcons = menuSkillTypeIcons + 0xC);
PROVIDE(movMpegWork = movSkipButtons + 0x4);
PROVIDE(movPadSlot = movListType + 0x4);
PROVIDE(movPktStripR = movPktIpartLabelAlpha + 0x4);
PROVIDE(padPort0Trigger = padPort0 + 0x4);
PROVIDE(ptclDataFileName = __rodata_main_4019F8);
PROVIDE(sndIopHeader = sndIopStatusAddr + 0x4);
PROVIDE(sndSeLoadState = sndSeWork + 0x4C);
PROVIDE(sysBattleBoot = sysState + 0xA);
PROVIDE(sysDataHeap = sysHeapBattleMagic + 0x4);
PROVIDE(sysDebugMode = sysLoopFrameCount + 0x4);
PROVIDE(sysDemoMode = sysDemo + 0x1);
PROVIDE(sysDemoReady = sysDemo + 0x2);
PROVIDE(sysDemoSkipped = sysDemo + 0x57);
PROVIDE(sysIniViewerMip = sysIni + 0xE);
PROVIDE(sysNewGameFlag = gphFbDivParam + 0x5C);
PROVIDE(sysOptCamReverse = sysSaveData + 0x25);
PROVIDE(sysProgChangeReq = sysState + 0xF);
PROVIDE(sysSavePlayTime = sysSaveData + 0x1C);
PROVIDE(sysScreenCaptureAddr = sysDbgMenuFlags + 0x1C);
PROVIDE(sysScreenCaptureReq = sysDbgMenuFlags + 0x21);
PROVIDE(vuMtxPoolCur = vuMtxPool + 0x4);
